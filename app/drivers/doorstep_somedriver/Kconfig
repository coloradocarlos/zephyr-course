## app/drivers/doorstep_somedriver/Kconfig
```kconfig
menuconfig DOORSTEP_SOMEDRIVER
	bool "My Custom Driver"
	default y
	depends on GPIO
	depends on DT_HAS_DOORSTEP_SOMEDRIVER_ENABLED
	help
	  Enable the custom driver when a doorstep,somedriver devicetree node is present (status okay).

if DOORSTEP_SOMEDRIVER

config DOORSTEP_INIT_PRIORITY
	int "Doorstep driver init priority"
	default 90
	help
	  Initialization priority for doorstep device instances (see SYS_INIT / kernel priorities).

endif # DOORSTEP_SOMEDRIVER
```

## dts/bindings/doorstep,somedriver.yaml
```yaml
description: Some driver (course stub)
compatible: doorstep,somedriver

include: base.yaml
```
