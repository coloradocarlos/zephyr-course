## app/boards/my_better_board/Kconfig.defconfig
```kconfig
# Copyright (c) 2024 Antmicro <www.antmicro.com>
# SPDX-License-Identifier: Apache-2.0

if BOARD_MY_BETTER_BOARD

config SPI_STM32_INTERRUPT
	default y
	depends on SPI

# select BOARD_EARLY_INIT_HOOK

endif # BOARD_MY_BETTER_BOARD
```

## app/boards/my_better_board/Kconfig.my_better_board
```kconfig
# Copyright (c) 2024 Antmicro <www.antmicro.com>
# SPDX-License-Identifier: Apache-2.0

config BOARD_MY_BETTER_BOARD
	select SOC_OSD32MP15X
	select BOARD_EARLY_INIT_HOOK
```

## app/boards/my_better_board/board.yml
```yaml
board:
  name: my_better_board
  full_name: My Better Board
  vendor: doorstep
  revision:
    format: major.minor.patch
    default: "1.0.0"
    revisions:
      - name: "1.0.0"
  socs:
    - name: osd32mp15x
```

## app/boards/my_little_board/Kconfig.defconfig
```kconfig
# Copyright (c) 2024 Antmicro <www.antmicro.com>
# SPDX-License-Identifier: Apache-2.0

if BOARD_MY_LITTLE_BOARD

config SPI_STM32_INTERRUPT
	default y
	depends on SPI

endif # BOARD_MY_LITTLE_BOARD
```

## app/boards/my_little_board/Kconfig.my_little_board
```kconfig
# Copyright (c) 2024 Antmicro <www.antmicro.com>
# SPDX-License-Identifier: Apache-2.0

config BOARD_MY_LITTLE_BOARD
	select SOC_OSD32MP15X
```

## app/boards/my_little_board/board.yml
```yaml
board:
  name: my_little_board
  full_name: My Little Board
  vendor: doorstep
  revision:
    format: major.minor.patch
    default: "1.0.0"
    revisions:
      - name: "1.0.0"
  socs:
    - name: osd32mp15x
```
